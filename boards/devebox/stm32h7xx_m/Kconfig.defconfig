## boards/devebox/stm32h7xx_m/Kconfig.defconfig
```kconfig
# DevEBox STM32H7XX M board configuration
# Copyright (c) 2026 Vishva
# SPDX-License-Identifier: Apache-2.0

if BOARD_DEVEBOX_STM32H7XX_M

source "boards/common/usb/Kconfig.cdc_acm_serial.defconfig"

endif # BOARD_DEVEBOX_STM32H7XX_M
```

## boards/devebox/stm32h7xx_m/Kconfig.devebox_stm32h7xx_m
```kconfig
# Copyright (c) 2026 Vishva
# SPDX-License-Identifier: Apache-2.0

config BOARD_DEVEBOX_STM32H7XX_M
	select SOC_STM32H743XX
```

## boards/devebox/stm32h7xx_m/board.yml
```yaml
board:
  name: devebox_stm32h7xx_m
  full_name: DevEBox STM32H7xx M
  vendor: others
  socs:
    - name: stm32h743xx
```
